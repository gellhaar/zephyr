## drivers/gpio/Kconfig.gecko
```kconfig
# Gecko GPIO configuration options

# Copyright (c) 2017 Christian Taedcke
# Copyright (c) 2025 Jonny Gellhaar
# SPDX-License-Identifier: Apache-2.0

menuconfig GPIO_GECKO
	bool "Gecko GPIO driver"
	default y
	depends on DT_HAS_SILABS_GECKO_GPIO_PORT_ENABLED
	select SOC_GECKO_GPIO
	help
	  Enable the Gecko gpio driver.

config GPIO_GECKO_COMMON_INIT_PRIORITY
	int "Common initialization priority"
	depends on GPIO_GECKO
	default 39

config GPIO_GECKO_ZERO_LATENCY_IRQ
	bool "Cofigure GPIO as Zephyr zero latency IRQ"
	default n
	depends on GPIO_GECKO
	select ZERO_LATENCY_IRQS
	help
	  Make sure to read documentatino of zero latency IRQ and its
	  implications and potential dangers. Do not call kernel API
	  from the GPIO inerrupt callback.
```

## drivers/pwm/Kconfig.silabs
```kconfig
# Copyright (c) 2025 Silicon Laboratories Inc.
# SPDX-License-Identifier: Apache-2.0

config PWM_SILABS_TIMER
	bool "Silabs TIMER PWM driver"
	default y
	depends on DT_HAS_SILABS_TIMER_PWM_ENABLED
	select SILABS_SISDK_TIMER
	help
	  Enable the PWM driver for the TIMER peripheral on Silabs Series 2 SoCs.

	  The TIMER peripheral has three or more channels which share PWM period configuration.
	  The last configured period will apply to all channels.
```

## drivers/serial/Kconfig.bt
```kconfig
# Copyright (c) 2024 Croxel, Inc.
# Copyright (c) 2026 Jonny Gellhaar
# SPDX-License-Identifier: Apache-2.0

config UART_BT
	bool "UART over NUS Bluetooth LE"
	depends on BT_ZEPHYR_NUS
	depends on DT_HAS_ZEPHYR_NUS_UART_ENABLED
	select UART_INTERRUPT_DRIVEN
	select RING_BUFFER
	select EXPERIMENTAL
	help
	  Enable the UART over NUS Bluetooth driver, which can be used to pipe
	  serial data over Bluetooth LE GATT using NUS (Nordic UART Service).

if UART_BT

config UART_BT_EXTERNAL_NUS_INST
	bool "Use an externally provided NUS instance"
	help
	  When enabled, the UART BT driver does not create its own NUS GATT
	  service. Instead, it discovers a bt_nus_inst provided by the
	  application or another module. This allows the application to
	  control the NUS GATT service lifecycle dynamically, for example
	  to exclude it in production firmware.

config UART_BT_WORKQUEUE_PRIORITY
	int "UART NUS Work-queue Priority"
	default MAIN_THREAD_PRIORITY
	help
	  Select UART NUS Work-queue priority based on the application context.

config UART_BT_WORKQUEUE_STACK_SIZE
	int "UART NUS Work-queue Stack Size"
	default 1024
	help
	  Set UART NUS Work-queue Stack-size based on the application context.

endif
```

## dts/bindings/pwm/silabs,letimer-pwm.yaml
```yaml
description: |
  PWM controller using the LETIMER peripheral on Silicon Labs Series 2 SoCs.
  The LETIMER can output PWM signals up to 16 kHz. It does not support input capture.
compatible: "silabs,letimer-pwm"

include: [pwm-controller.yaml, pinctrl-device.yaml, base.yaml]

properties:
  pinctrl-0:
    required: true

  run-in-debug:
    type: boolean
    description: |
      Enable for PWM to keep running in debug mode.
  clock-div:
    type: int
    default: 1
    description: Clock divider for PWM signal
    enum:
      - 1
      - 2
      - 4
      - 8
      - 16
      - 32
      - 64
      - 128
      - 256

  "#pwm-cells":
    const: 3

pwm-cells:
  - channel
  - period
  - flags
```

## dts/bindings/pwm/silabs,timer-pwm.yaml
```yaml
description: |
  PWM controller using the TIMER peripheral on Silicon Labs Series 2 SoCs.

compatible: "silabs,timer-pwm"

include: [pwm-controller.yaml, pinctrl-device.yaml, base.yaml]

properties:
  pinctrl-0:
    required: true

  run-in-debug:
    type: boolean
    description: |
      Enable for PWM to keep running in debug mode.

  clock-div:
    type: int
    default: 1
    description: Clock divider for PWM signal
    enum:
      - 1
      - 2
      - 4
      - 8
      - 16
      - 32
      - 64
      - 128
      - 256
      - 512
      - 1024

  "#pwm-cells":
    const: 3

  channels:
    type: int
    required: true
    description: Number of PWM channels available

  counter-size:
    type: int
    required: true
    description: Width of the counter in bits
    enum:
      - 16
      - 32

pwm-cells:
  - channel
  - period
  - flags
```
